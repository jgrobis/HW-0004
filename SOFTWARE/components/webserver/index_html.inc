"<!doctype html><html lang=\"pl\"><head><meta charset=\"utf-8\">\n"
"<meta name=\"viewport\" content=\"width=device-width,initial-scale=1\">\n"
"<title>Nixie Clock</title><style>\n"
":root{--bg:#0f1115;--card:#1b1f27;--fg:#e8e8e8;--mut:#9aa3af;--acc:#ff8a3d;--bad:#ef6b6b;--ok:#5fd07a}\n"
"*{box-sizing:border-box}body{margin:0;background:var(--bg);color:var(--fg);font-family:system-ui,sans-serif;line-height:1.4}.wrap{max-width:760px;margin:0 auto;padding:16px}\n"
"h1{font-size:20px;margin:8px 0 4px}.sub{color:var(--mut);font-size:13px;margin-bottom:12px}.clock{font-size:44px;font-weight:700;letter-spacing:3px;text-align:center;padding:10px 0;color:var(--acc)}\n"
".card{background:var(--card);border-radius:12px;padding:12px 14px;margin:10px 0}.card h2{font-size:14px;margin:0 0 8px;color:var(--mut);text-transform:uppercase;letter-spacing:1px}\n"
"button{background:#2a3140;color:var(--fg);border:0;border-radius:8px;padding:9px 14px;margin:3px 4px 3px 0;font-size:14px;cursor:pointer}button:hover{background:#39414f}button.active,button.acc{background:var(--acc);color:#181818;font-weight:700}\n"
"label{font-size:13px;color:var(--mut);margin-right:6px}input,select{background:#10141b;color:var(--fg);border:1px solid #2a3140;border-radius:7px;padding:7px;font-size:14px;margin:3px 6px 3px 0;max-width:100%}input[type=number]{width:86px}.wide{width:230px}.row{display:flex;flex-wrap:wrap;align-items:center}.kv{font-size:13px;color:var(--mut)}.kv b{color:var(--fg)}.ok{color:var(--ok)}.bad{color:var(--bad)}.msg{font-size:13px;color:var(--mut);margin-top:6px}\n"
"</style></head><body><div class=\"wrap\">\n"
"<h1>Nixie Clock</h1><div class=\"sub\">panel testowy &middot; ESP32-C6</div><div class=\"clock\" id=\"clk\">--:--</div>\n"
"<div class=\"card\"><h2>Bezpieczenstwo</h2><div class=\"row\"><label>token admin/OTA</label><input id=\"admintok\" class=\"wide\" type=\"password\" placeholder=\"domyslnie: nixie-ota\"><button onclick=\"savetok()\">Zapamietaj w tej przegladarce</button></div><div class=\"msg\" id=\"authmsg\">Wszystkie akcje POST wymagaja tokenu. Domyslny token po czystym flashu: <b>nixie-ota</b>. Zmien go po pierwszym uruchomieniu.</div></div>\n"
"<div class=\"card\"><h2>Status</h2><div class=\"kv\" id=\"st\">...</div></div>\n"
"<div class=\"card\"><h2>Zasilanie HV</h2><button id=\"hvOn\" onclick=\"j('/api/hv',{on:true})\">Wlacz</button><button id=\"hvOff\" onclick=\"j('/api/hv',{on:false})\">Wylacz totalnie</button></div>\n"
"<div class=\"card\"><h2>Sterowanie HV_EN</h2><div class=\"row\"><label>driver</label><select id=\"hvdrv\" class=\"wide\"><option value=\"mmbta_direct_base\">MMBTA/open-collector testowy</option><option value=\"open_drain_pullup\">2N7002/BSS138 open-drain</option></select><button class=\"acc\" onclick=\"sethvdriver()\">Zapisz driver</button></div><div class=\"msg\">Oba tryby zakladaja wbudowany pull-up EN w module HV. Nie ma trybu bezposredniego GPIO->EN. Zmiana drivera wymusza HV OFF.</div></div>\n"
"<div class=\"card\"><h2>Tryb</h2><button id=\"modeNtp\" onclick=\"j('/api/mode',{mode:'ntp'})\">NTP</button><button id=\"modeManual\" onclick=\"j('/api/mode',{mode:'manual'})\">Reczny</button><button onclick=\"j('/api/sync',{})\">Synchronizuj teraz</button></div>\n"
"<div class=\"card\"><h2>Reczne ustawienie czasu</h2><div class=\"row\"><label>godz</label><input id=\"hh\" type=\"number\" min=\"0\" max=\"23\" value=\"12\"><label>min</label><input id=\"mm\" type=\"number\" min=\"0\" max=\"59\" value=\"0\"><button class=\"acc\" onclick=\"settime()\">Ustaw</button></div></div>\n"
"<div class=\"card\"><h2>WiFi</h2><div class=\"kv\" id=\"wifist\">...</div><div class=\"row\"><button onclick=\"scanwifi()\">Skanuj WiFi</button><select id=\"wifiList\" class=\"wide\" onchange=\"pickwifi()\"><option value=\"\">-- skan --</option></select></div><div class=\"row\"><label>SSID</label><input id=\"ssid\" class=\"wide\" maxlength=\"32\"><label>haslo</label><input id=\"pass\" class=\"wide\" maxlength=\"64\" type=\"password\"><button class=\"acc\" onclick=\"savewifi()\">Zapisz i polacz</button></div><div class=\"msg\" id=\"wmsg\">Gdy STA nie polaczy sie z routerem, zegar uruchamia AP: <b>NIXIE-SETUP</b>, haslo: <b>nixie1234</b>. Panel zwykle jest wtedy pod 192.168.4.1.</div></div>\n"
"<div class=\"card\"><h2>Oszczedzanie WiFi</h2><div class=\"row\"><label>tryb</label><select id=\"wpwr\"><option value=\"performance\">Responsywny - PS off</option><option value=\"balanced\">Balanced - MIN modem sleep</option><option value=\"max_save\">Max saving - MAX modem sleep</option><option value=\"on_demand\">On demand - WiFi tylko okno czasowe</option></select><label>okno aktywne</label><select id=\"wwin\"><option value=\"1\">1 min</option><option value=\"3\">3 min</option><option value=\"5\">5 min</option><option value=\"10\">10 min</option><option value=\"30\">30 min</option><option value=\"60\">60 min</option></select><button class=\"acc\" onclick=\"setwifipower()\">Zapisz</button></div><div class=\"msg\">W trybie on demand WiFi gasnie po oknie aktywnym. Podczas OTA nie zostanie wylaczone.</div></div>\n"
"<div class=\"card\"><h2>Synchronizacja czasu</h2><div class=\"row\"><label>co ile</label><select id=\"ntpi\"><option value=\"5\">5 min</option><option value=\"15\">15 min</option><option value=\"30\">30 min</option><option value=\"60\">1 h</option><option value=\"180\">3 h</option><option value=\"360\">6 h</option><option value=\"720\">12 h</option><option value=\"1440\">24 h</option></select><button class=\"acc\" onclick=\"setntp()\">Zapisz</button></div><div class=\"msg\">Po starcie synchronizuje od razu, potem wedlug tego interwalu.</div></div>\n"
"<div class=\"card\"><h2>Anti-poisoning</h2><button id=\"apOn\" onclick=\"j('/api/antipoison',{enabled:true})\">Wlacz auto</button><button id=\"apOff\" onclick=\"j('/api/antipoison',{enabled:false})\">Wylacz auto</button><button onclick=\"j('/api/antipoison',{run:true})\">Uruchom teraz</button><div class=\"msg\">Reczny start ma cooldown, zeby nie spamowac lamp. Wylaczenie auto przerywa trwajaca rutyne auto.</div></div>\n"
"<div class=\"card\"><h2>Czujnik ruchu/obecnosci</h2><button id=\"motOn\" onclick=\"j('/api/motion',{enabled:true})\">Wlacz</button><button id=\"motOff\" onclick=\"j('/api/motion',{enabled:false})\">Wylacz</button><div class=\"msg\">Opcja przygotowana programowo. Fizyczny czujnik moze byc dolozony pozniej.</div></div>\n"
"<div class=\"card\"><h2>OTA update</h2><div class=\"kv\" id=\"otast\">...</div><div class=\"row\"><label>nowy token</label><input id=\"newtok\" class=\"wide\" type=\"password\" maxlength=\"64\"><button onclick=\"setotatok()\">Zmien token</button></div><div class=\"row\"><input id=\"otafile\" type=\"file\" accept=\".bin\"><button class=\"acc\" onclick=\"otaupdate()\">Wgraj firmware .bin</button></div><div class=\"msg\" id=\"otamsg\">OTA uzywa naglowka X-OTA-Token, nie tokenu w URL. Po OTA urzadzenie samo zrobi bezpieczny restart z HV OFF.</div></div>\n"
"<div class=\"card\"><h2>Kalibracja (bit 0..28)</h2><div class=\"row\"><input id=\"ci\" type=\"number\" min=\"0\" max=\"28\" value=\"0\"><button onclick=\"calib()\">Zapal bit</button></div><div class=\"kv\" id=\"cres\"></div></div>\n"
"<script>\n"
"function g(i){return document.getElementById(i)}\n"
"function active(i,on){var e=g(i);if(e)e.classList.toggle('active',!!on)}\n"
"function tok(){return g('admintok').value||localStorage.getItem('nixie_admin_token')||''}\n"
"function savetok(){localStorage.setItem('nixie_admin_token',tok());g('authmsg').textContent='Token zapisany lokalnie w tej przegladarce.'}\n"
"function h(json){let x={'X-Admin-Token':tok()};if(json)x['Content-Type']='application/json';return x}\n"
"async function parseResp(r){let x={ok:false,status:r.status};try{x=await r.json()}catch(e){}if(!r.ok){x.ok=false;x.status=r.status}return x}\n"
"function j(u,b){localStorage.setItem('nixie_admin_token',tok());return fetch(u,{method:'POST',headers:h(true),body:JSON.stringify(b)}).then(parseResp).then(x=>{if(!x.ok&&x.status===401)g('authmsg').textContent='Zly token albo brak tokenu.';refresh();return x})}\n"
"function settime(){j('/api/time',{hh:+g('hh').value,mm:+g('mm').value})}\n"
"function calib(){j('/api/calib',{index:+g('ci').value}).then(x=>{g('cres').textContent=x.bit||'blad'})}\n"
"function setntp(){j('/api/ntp',{interval_min:+g('ntpi').value})}\n"
"function setwifipower(){j('/api/wifi_power',{mode:g('wpwr').value,window_min:+g('wwin').value})}\n"
"function sethvdriver(){j('/api/hv_driver',{mode:g('hvdrv').value}).then(x=>{if(x.ok)g('authmsg').textContent='Driver HV zapisany. HV zostalo wylaczone dla bezpieczenstwa.';else g('authmsg').textContent='Blad zapisu drivera HV albo tokenu.'})}\n"
"function savewifi(){j('/api/wifi',{ssid:g('ssid').value,pass:g('pass').value}).then(x=>{g('wmsg').textContent=x.ok?'Zapisano. Lacze ponownie...':'Blad zapisu WiFi albo tokenu.'})}\n"
"function scanwifi(){g('wmsg').textContent='Skanuje...';fetch('/api/wifi_scan').then(r=>r.json()).then(a=>{let s=g('wifiList');s.innerHTML='<option value=\"\">-- wybierz --</option>';a.forEach(x=>{let o=document.createElement('option');o.value=x.ssid;o.textContent=x.ssid+' ('+x.rssi+' dBm)';s.appendChild(o)});g('wmsg').textContent=a.length?'Znaleziono sieci.':'Nie znaleziono sieci albo skan chwilowo niedostepny.'})}\n"
"function pickwifi(){if(g('wifiList').value)g('ssid').value=g('wifiList').value}\n"
"function setotatok(){let nt=g('newtok').value;j('/api/ota_token',{new_token:nt}).then(x=>{if(x.ok){g('admintok').value=nt;localStorage.setItem('nixie_admin_token',nt);g('otamsg').textContent='Token zmieniony i zapisany w tej przegladarce.'}else g('otamsg').textContent='Blad: stary token zly albo nowy token ma mniej niz 4 znaki.'})}\n"
"async function otaupdate(){let f=g('otafile').files[0];let t=tok();if(!f){g('otamsg').textContent='Wybierz plik .bin';return}if(!t){g('otamsg').textContent='Wpisz token admin/OTA';return}localStorage.setItem('nixie_admin_token',t);g('otamsg').textContent='Wgrywam '+f.name+'...';try{let r=await fetch('/api/ota',{method:'POST',headers:{'Content-Type':'application/octet-stream','X-OTA-Token':t},body:f});let x=await parseResp(r);g('otamsg').textContent=x.ok?'Wgrano. Bezpieczny restart...':'Blad OTA / tokenu: HTTP '+(x.status||'?')}catch(e){g('otamsg').textContent='Polaczenie przerwane albo urzadzenie juz restartuje.'}}\n"
"function refresh(){fetch('/api/status').then(r=>r.json()).then(s=>{g('clk').textContent=s.time?s.time.slice(0,5):'--:--';g('st').innerHTML='czas: <b>'+s.time+'</b> ('+(s.time_valid?'<span class=\"ok\">zsync</span>':'<span class=\"bad\">brak sync</span>')+')<br>tryb: <b>'+s.mode+'</b> &middot; HV: <b>'+(s.hv?'ON':'OFF')+'</b><br>anti-poison: <b>'+(s.antipoison?'ON':'OFF')+'</b> &middot; czujnik: <b>'+(s.motion?'ON':'OFF')+'</b><br>NTP co: <b>'+s.ntp_interval_min+' min</b><br>driver HV_EN: <b>'+(s.hv_driver||'-')+'</b>';g('wifist').innerHTML='STA: <b>'+(s.wifi?'OK':(s.wifi_started?'brak IP':'WiFi OFF'))+'</b> &middot; SSID: <b>'+(s.ssid||'-')+'</b> &middot; RSSI: <b>'+s.rssi+'</b> dBm<br>AP setup: <b>'+(s.ap?s.ap_ssid:'OFF')+'</b><br>power: <b>'+s.wifi_power+'</b> &middot; okno: <b>'+s.wifi_window_min+' min</b>';g('otast').innerHTML='FW: <b>'+(s.fw_version||'-')+'</b> &middot; OTA partycja: <b>'+(s.ota_ready?'OK':'BRAK')+'</b>';g('ssid').placeholder=s.ssid||'SSID';g('ntpi').value=String(s.ntp_interval_min);g('wpwr').value=s.wifi_power||'balanced';g('wwin').value=String(s.wifi_window_min||5);g('hvdrv').value=s.hv_driver||'mmbta_direct_base';active('hvOn',s.hv);active('hvOff',!s.hv);active('modeNtp',s.mode==='ntp');active('modeManual',s.mode==='manual');active('apOn',s.antipoison);active('apOff',!s.antipoison);active('motOn',s.motion);active('motOff',!s.motion)})}\n"
"g('admintok').value=localStorage.getItem('nixie_admin_token')||'';refresh();setInterval(refresh,1500);\n"
"</script></div></body></html>\n"
