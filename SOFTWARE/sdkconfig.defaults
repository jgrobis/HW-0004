## SOFTWARE/sdkconfig.defaults
```kconfig
# Target
CONFIG_IDF_TARGET="esp32c6"

# --- Flash: module is ESP32-C6-MINI-1-N4 (4 MB) ---
CONFIG_ESPTOOLPY_FLASHSIZE_4MB=y
CONFIG_ESPTOOLPY_FLASHSIZE="4MB"

# --- Power management: automatic light sleep (event-driven, low power) ---
CONFIG_PM_ENABLE=y
CONFIG_FREERTOS_USE_TICKLESS_IDLE=y
CONFIG_PM_DFS_INIT_AUTO=y
CONFIG_PM_SLP_IRAM_OPT=y
CONFIG_PM_RTOS_IDLE_OPT=y
CONFIG_ESP_WIFI_SLP_IRAM_OPT=y

# --- FreeRTOS ---
CONFIG_FREERTOS_HZ=1000

# --- SNTP: we use two servers (primary + GUM fallback) ---
CONFIG_LWIP_SNTP_MAX_SERVERS=2
CONFIG_LWIP_DHCP_GET_NTP_SRV=n

# --- HTTP server ---
CONFIG_HTTPD_MAX_REQ_HDR_LEN=1024

# --- Logging ---
CONFIG_LOG_DEFAULT_LEVEL_INFO=y

# --- ESP-IDF v6: default warnings are errors. If a stray warning blocks the
#     build, uncomment the next line to demote warnings back to warnings: ---
# CONFIG_COMPILER_DISABLE_DEFAULT_ERRORS=y
# CONFIG_PARTITION_TABLE_SINGLE_APP is not set
# CONFIG_PARTITION_TABLE_SINGLE_APP_LARGE is not set
# CONFIG_PARTITION_TABLE_TWO_OTA is not set
# CONFIG_PARTITION_TABLE_TWO_OTA_LARGE is not set
CONFIG_PARTITION_TABLE_CUSTOM=y
CONFIG_PARTITION_TABLE_CUSTOM_FILENAME="partitions_ota.csv"
CONFIG_PARTITION_TABLE_FILENAME="partitions_ota.csv"
CONFIG_PARTITION_TABLE_OFFSET=0x8000
CONFIG_PARTITION_TABLE_MD5=y
CONFIG_APP_ROLLBACK_ENABLE=y
CONFIG_BOOTLOADER_APP_ROLLBACK_ENABLE=y
```
